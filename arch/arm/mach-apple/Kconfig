## arch/arm/mach-apple/Kconfig
```kconfig
if ARCH_APPLE

config TEXT_BASE
	default 0x00000000

config SYS_SOC
	default "apple"

config SYS_VENDOR
	default "apple"

config SYS_BOARD
	string "Board name"
	default "mac"
	help
	  This option contains information about board name.
	  Based on this option board/<CONFIG_SYS_VENDOR>/<CONFIG_SYS_BOARD> will
	  be used.
	  Apple silicon based devices are expected to use the generic board name
	  "mac".

config SYS_MALLOC_LEN
	default 0x4000000

config SYS_MALLOC_F_LEN
	default 0x4000

config LNX_KRNL_IMG_TEXT_OFFSET_BASE
	default TEXT_BASE

config APPLE_J713_FDT
	bool "Support J713 per-kernel device-tree handoff"
	depends on OF_BOARD_SETUP && APPLE_MTP_KEYB
	help
	  Import the live J713 firmware resources into an explicitly selected
	  kernel device tree. This requires the retained MTP helper and at least
	  208 KiB of SYS_FDT_PAD. Enable this for the shared Apple boot image;
	  other Apple configurations can keep their existing FDT allocation.

endif
```

## configs/apple_j873_defconfig
```kconfig
CONFIG_ARM=y
CONFIG_ARCH_APPLE=y
CONFIG_DEFAULT_DEVICE_TREE="apple/t8103-j274"
CONFIG_SYS_BOOTM_LEN=0x40000000
CONFIG_SYS_LOAD_ADDR=0x0
CONFIG_EFI_VARIABLE_NO_STORE=y
CONFIG_BOOTDELAY=-1
CONFIG_BOOTCOMMAND="echo J873g RAM boot ready"
# CONFIG_DISPLAY_CPUINFO is not set
CONFIG_DISPLAY_BOARDINFO_LATE=y
CONFIG_BOARD_LATE_INIT=y
CONFIG_CMD_SMBIOS=y
CONFIG_CMD_BOOTEFI_HELLO=y
CONFIG_CMD_EFIDEBUG=y
CONFIG_CMD_SELECT_FONT=y
CONFIG_OF_UPSTREAM_BUILD_VENDOR=y
CONFIG_OF_UPSTREAM_VENDOR="apple"
CONFIG_NO_NET=y
CONFIG_SYS_64BIT_LBA=y
CONFIG_MISC=y
# CONFIG_MMC is not set
CONFIG_NVME_APPLE=y
CONFIG_APPLE_DOCKCHANNEL_SERIAL=y
CONFIG_SYSINFO=y
CONFIG_SYSINFO_SMBIOS=y
CONFIG_USB_XHCI_HCD=y
CONFIG_USB_XHCI_DWC3=y
CONFIG_USB_DWC3=y
CONFIG_VIDEO_FONT_16X32=y
CONFIG_SYS_WHITE_ON_BLACK=y
CONFIG_NO_FB_CLEAR=y
CONFIG_VIDEO_SIMPLE=y
CONFIG_GENERATE_SMBIOS_TABLE_VERBOSE=y
```
